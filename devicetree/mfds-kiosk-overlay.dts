/dts-v1/;
/plugin/;

/ {
    compatible = "brcm,bcm2835", "brcm,bcm2711";

    /* Fragment 0: Pinmux configuration for MFDS Kiosk Button and LED */
    fragment@0 {
        target = <&gpio>;
        __overlay__ {
            mfds_pins: mfds_pins {
                brcm,pins = <17 27>;
                brcm,function = <0 1>; /* GPIO 17: Input (0), GPIO 27: Output (1) */
                brcm,pull = <2 0>;     /* GPIO 17: Pull-Up (2), GPIO 27: None (0) */
            };
        };
    };

    /* Fragment 1: Instantiate MFDS Kiosk Controller Platform Device */
    fragment@1 {
        target-path = "/";
        __overlay__ {
            mfds_ctrl: mfds_ctrl {
                compatible = "mfds,kiosk-ctrl";
                label = "MFDS Kiosk Hardware Controller";
                pinctrl-names = "default";
                pinctrl-0 = <&mfds_pins>;
                button-gpios = <&gpio 17 1>; /* Active Low */
                led-gpios = <&gpio 27 0>;    /* Active High */
                status = "okay";
            };
        };
    };
};
